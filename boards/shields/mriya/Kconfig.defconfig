## boards/shields/mriya/Kconfig.defconfig
```kconfig
if SHIELD_MRIYA_DONGLE || SHIELD_MRIYA_LEFT_MAIN || SHIELD_MRIYA_LEFT_MAIN_DISPLAY || SHIELD_MRIYA_RIGHT_MAIN || SHIELD_MRIYA_RIGHT_MAIN_DISPLAY

config ZMK_KEYBOARD_NAME
    default "MRIYA"

config ZMK_SPLIT_ROLE_CENTRAL
    default y

endif

if SHIELD_MRIYA_DONGLE || SHIELD_MRIYA_LEFT_MAIN || SHIELD_MRIYA_LEFT_MAIN_DISPLAY || SHIELD_MRIYA_RIGHT_MAIN || SHIELD_MRIYA_RIGHT_MAIN_DISPLAY || SHIELD_MRIYA_LEFT_SECONDARY || SHIELD_MRIYA_LEFT_SECONDARY_DISPLAY || SHIELD_MRIYA_RIGHT_SECONDARY || SHIELD_MRIYA_RIGHT_SECONDARY_DISPLAY

config ZMK_SPLIT
    default y

endif

if SHIELD_MRIYA_LEFT_MAIN || SHIELD_MRIYA_LEFT_MAIN_DISPLAY || SHIELD_MRIYA_RIGHT_MAIN || SHIELD_MRIYA_RIGHT_MAIN_DISPLAY

config ZMK_SPLIT_BLE_CENTRAL_PERIPHERALS
    default 1

endif

if SHIELD_MRIYA_DONGLE

config ZMK_SPLIT_BLE_CENTRAL_PERIPHERALS
    default 2

endif

if SHIELD_MRIYA_LEFT_MAIN_DISPLAY || SHIELD_MRIYA_LEFT_SECONDARY_DISPLAY || SHIELD_MRIYA_RIGHT_MAIN_DISPLAY || SHIELD_MRIYA_RIGHT_SECONDARY_DISPLAY

config I2C
    default y

config SSD1306
    default y

if LVGL

config LV_Z_VDB_SIZE
    default 64

config LV_DPI_DEF
    default 148

config LV_Z_BITS_PER_PIXEL
    default 1

choice LV_COLOR_DEPTH
    default LV_COLOR_DEPTH_1
endchoice

endif # LVGL

endif
```

## boards/shields/mriya/Kconfig.shield
```kconfig
# Copyright (c) 2020 Pete Johanson
# SPDX-License-Identifier: MIT

config SHIELD_MRIYA_DONGLE
    def_bool $(shields_list_contains,mriya_dongle)

config SHIELD_MRIYA_LEFT_MAIN
    def_bool $(shields_list_contains,mriya_left_main)

config SHIELD_MRIYA_LEFT_MAIN_DISPLAY
    def_bool $(shields_list_contains,mriya_left_main_display)

config SHIELD_MRIYA_LEFT_SECONDARY
    def_bool $(shields_list_contains,mriya_left_secondary)

config SHIELD_MRIYA_LEFT_SECONDARY_DISPLAY
    def_bool $(shields_list_contains,mriya_left_secondary_display)

config SHIELD_MRIYA_RIGHT_MAIN
    def_bool $(shields_list_contains,mriya_right_main)

config SHIELD_MRIYA_RIGHT_MAIN_DISPLAY
    def_bool $(shields_list_contains,mriya_right_main_display)

config SHIELD_MRIYA_RIGHT_SECONDARY
    def_bool $(shields_list_contains,mriya_right_secondary)

config SHIELD_MRIYA_RIGHT_SECONDARY_DISPLAY
    def_bool $(shields_list_contains,mriya_right_secondary_display)
```
